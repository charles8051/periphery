/*
 * treehopper.c
 *
 *  Created on: Jul 19, 2015
 *      Author: jay
 */

#include <SI_EFM8UB1_Register_Enums.h>
#include <efm8_usb.h>
#include "descriptors.h"
#include "treehopper.h"
#include "gpio.h"
#include "adc.h"
#include "pwm.h"
#include "led.h"
#include "spi.h"
#include "i2c.h"
#include "serialNumber.h"
#include "softPwm.h"
#include "uart.h"
#include "parallel.h"

// GLOBALS
SI_SEGMENT_VARIABLE( Treehopper_ReportData[TREEHOPPER_NUM_PINS*2+1], uint8_t, SI_SEG_XDATA);
SI_SEGMENT_VARIABLE( lastReportData[TREEHOPPER_NUM_PINS*2+1], uint8_t, SI_SEG_XDATA);
SI_SEGMENT_VARIABLE(Treehopper_PinConfig, pinConfigPacket_t, SI_SEG_XDATA);
SI_SEGMENT_VARIABLE( Treehopper_PeripheralConfig[262], uint8_t, SI_SEG_XDATA); // 255+7 bytes for larger SPI header.
SI_SEGMENT_VARIABLE( Treehopper_RxBuffer[255], uint8_t, SI_SEG_XDATA);

// PROTOTYPES
void ProcessPeripheralConfigPacket();
void ProcessPinConfigPacket();
void SendPinStatus();

uint16_t timeout = 0;

// ── EP_PeripheralConfig stream framing (issue #170) ──────────────────────────
// Set from the USB ISR (USBD_XferCompleteCb, callback.c) on every EP_PeripheralConfig
// packet: true when that packet was short, which is how the host marks the end of its
// transfer. A single bit is deliberate - SETB / CLR on a bdata bit is one instruction, so
// there is no read-modify-write window between the ISR and the foreground.
volatile bit Treehopper_PeripheralConfigShortPacket = 0;

// Latched when the stream's framing is known to be lost - by the foreground when it
// abandons a multi-packet read, and by the USB ISR when a re-enumeration re-points the
// endpoint out from under one. Consumed by the drain at the top of
// ProcessPeripheralConfigPacket.
volatile bit Treehopper_PeripheralConfigDesync = 0;

// Set by the foreground for exactly as long as it owns a continuation read armed at
// &Treehopper_PeripheralConfig[64]. Read by USBD_DeviceStateChangeCb, which must re-arm at
// offset 0 on every transition to CONFIGURED (that is what recovers the endpoint from the
// D_EP_HALT a bus reset leaves it in) and so needs to know when doing that steals a read
// the foreground is still spinning on.
volatile bit Treehopper_PeripheralConfigMultiRead = 0;

// LOCALS
SI_SEGMENT_VARIABLE(pins[TREEHOPPER_NUM_PINS], uint8_t, SI_SEG_XDATA);

void Treehopper_Init() {
	int i;

	// Guarantee the watchdog is on, and lock it on.
	//
	// The 0xA5 is belt-and-braces: the WDT is already running out of reset (RM sec. 23.3,
	// "The WDT is enabled and reset as a result of any system reset"), and InitDevice.c no
	// longer disables it. But InitDevice.c is generated by the Hardware Configurator and is
	// rewritten whenever the .hwconf is saved, so re-enabling here keeps the watchdog on even
	// if a regeneration ever reintroduces a disable sequence ahead of us.
	//
	// The 0xFF then locks out the disable feature until the next system reset (RM sec. 23.3:
	// "Applications always intending to use the watchdog should write 0xFF to WDTCN in the
	// initialization code"). Note 0xFF does not itself enable or feed, hence the order.
	WDTCN = 0xA5;
	WDTCN = 0xFF;

	// re-init all the buffers
	memset(Treehopper_ReportData, 0, sizeof(Treehopper_ReportData));
	memset(lastReportData, 0, sizeof(lastReportData));
	memset(&Treehopper_PinConfig, 0, sizeof(pinConfigPacket_t));
	memset(Treehopper_PeripheralConfig, 0, sizeof(Treehopper_PeripheralConfig));

	memset(Treehopper_RxBuffer, 0, sizeof(Treehopper_RxBuffer));

	SerialNumber_Init();
	LED_Init();
	PWM_Init();
	SPI_Disable();
	UART_Disable();
	I2C_Disable();
	PWM_Disable();
	SoftPwm_Init();

	for(i=0; i<TREEHOPPER_NUM_PINS;i++)
	{
		GPIO_MakeInput(i, true);

		// While we want all the pins to be weakly-pulled-up inputs by default, we don't actually want to send
		// input reports on these pins, since this unnecessarily calls GPIO_ReadValue() continuously on each pin.
		//
		// More importantly, if they're DigitalInputs, it prevents missing the first pin change when it *is* a digital input,
		// since SendPinStatus() will certainly send at least once before we receive any pin config packets
		// (and thus, get discarded by an unexpecting host API that doesn't think any pins are DigitalInputs).
		// Since SendPinStatus() only sends when pins change, we'll never get our initial digital value to the host.
		//
		// To remedy this, make the inputs anything other than an input so that SendPinStatus() sends (and records) 0xff
		// current values. Then, when the pin mode is changed to a DigitalInput, we're guaranteed to get a pin report packet
		// flushed out (since the high byte of a DigitalInput report is always 0, and never 0xff).
		pins[i] = ReservedPin;

	}

}

void Treehopper_Task() {
	DEBUG_HIGH();
	if (!USBD_EpIsBusy(EP_PinConfig)) {
		ProcessPinConfigPacket();
	}
	if (!USBD_EpIsBusy(EP_PeripheralConfig)) {
		ProcessPeripheralConfigPacket();
	}
	if(!USBD_EpIsBusy(EP_PinStatus))
		SendPinStatus();
	DEBUG_LOW();
}

void SendPinStatus() {
	uint8_t i = 0;
	uint16_t val;
	Treehopper_ReportData[0] = DeviceResponse_CurrentReadings;
	for (i = 0; i < 20; i++) {
		switch (pins[i]) {
		case DigitalInput:
			Treehopper_ReportData[i * 2 + 1] = GPIO_ReadValue(i);
			Treehopper_ReportData[i * 2 + 2] = 0;
			break;
		case AnalogInput:
			val = ADC_GetVal(i);
			Treehopper_ReportData[i * 2 + 1] = val >> 8;
			Treehopper_ReportData[i * 2 + 2] = val & 0xFF;
			break;
		default:
			Treehopper_ReportData[i * 2 + 1] = 0xff;
			Treehopper_ReportData[i * 2 + 2] = 0xff;
		}
	}
	// if the pins have changed, send the update. Otherwise no need!
	if(memcmp(lastReportData, Treehopper_ReportData, sizeof(Treehopper_ReportData)) != 0)
	{
		USBD_Write(EP1IN, Treehopper_ReportData, sizeof(Treehopper_ReportData), false);

		// save the old report so we can compare to it next time around to see if anything has changed
		memcpy(lastReportData, Treehopper_ReportData, sizeof(Treehopper_ReportData));
	}
}

void ProcessPinConfigPacket() {
	switch (Treehopper_PinConfig.PinCommand) {
		case PinConfig_MakeDigitalInput:
			GPIO_MakeInput(Treehopper_PinConfig.PinNumber, true);
			break;
		case PinConfig_MakeAnalogInput:
			ADC_Enable(Treehopper_PinConfig.PinNumber,
					Treehopper_PinConfig.PinConfigData[0]);
			break;
		case PinConfig_MakePushPullOutput:
			GPIO_MakeOutput(Treehopper_PinConfig.PinNumber, PushPullOutput);
			break;
		case PinConfig_MakeOpenDrainOutput:
			GPIO_MakeOutput(Treehopper_PinConfig.PinNumber, OpenDrainOutput);
			break;
		case PinConfig_SetDigitalValue:
			GPIO_WriteValue(Treehopper_PinConfig.PinNumber,
					Treehopper_PinConfig.PinConfigData[0]);
			break;
		}

	memset(&Treehopper_PinConfig, 0, sizeof(pinConfigPacket_t)); // reset the buffer to zero to avoid accidentally re-processing data
	// when we're all done, re-arm the endpoint.
	USBD_Read(EP_PinConfig, (uint8_t *)&Treehopper_PinConfig, sizeof(pinConfigPacket_t), false);
}

// this gets called whenever we received peripheral config data from the host
//
// FRAMING. This stream has none: no length prefix, no sequence number, no magic, no
// opcode validation. Whatever byte sits at Treehopper_PeripheralConfig[0] is executed as a
// command, and every low value is a live one - 0x0A FirmwareUpdateSerial,
// 0x0B FirmwareUpdateName, 0x0C Reboot, 0x0D EnterBootloader. So the ONLY thing standing
// between a desynchronised stream and a destroyed board is never re-arming this endpoint at
// offset 0 while the host is still sending the middle of a command.
//
// That is not hypothetical. Issue #170: an APA102 pixel flush chunks at 252 bytes, so every
// animation tick takes the multi-packet path below. When the remainder missed the spin
// budget, the abort discarded in-flight packets, the re-arm at the bottom of this function
// went back to offset 0, and the next surviving packet - pure pixel data - landed where an
// opcode was expected. A dim blue-white pixel is FF 0B 09 06; entered one byte late its Blue
// channel 0x0B is FirmwareUpdateName and its Green channel 0x09 is the length, so the board
// wrote its own pixel data over its name page. Two production boards permanently lost both
// their name and serial descriptors and three went into their bootloaders on a 0x0D.
void ProcessPeripheralConfigPacket() {
	uint8_t totalTransactionBytes;
	uint8_t totalReadBytes;
	uint8_t burst;
	SpiConfigData_t spiConfig;

	// DRAIN TO A PACKET BOUNDARY. Treehopper_PeripheralConfigDesync means we abandoned a multi-packet
	// read with the host still sending, so these bytes are the middle of that command and
	// not the start of a new one. Discard them, and keep discarding until a short packet -
	// the host's own end-of-transfer marker, and therefore the next boundary we can trust.
	//
	// If the abandoned command happened to be an exact multiple of the 64-byte packet size,
	// no short packet ends it and this eats the first packet of the NEXT command instead,
	// resynchronising on that command's short tail. One dropped command is a far better
	// failure than executing pixel data as EnterBootloader.
	if (Treehopper_PeripheralConfigDesync)
	{
		if (Treehopper_PeripheralConfigShortPacket)
			Treehopper_PeripheralConfigDesync = 0;
	}
	else
	switch (Treehopper_PeripheralConfig[0]) {
	case ConfigureDevice:
		// Was a configureDevice(Treehopper_PeripheralConfig[1]) wrapper that ignored its
		// argument and called this. Inlined to buy back flash for the framing fix below; the
		// app region ends at 0x3A00 (BUILD.md). A future per-configuration variant can read
		// Treehopper_PeripheralConfig[1] here.
		Treehopper_Init();
		break;

	case PWMConfig:
		PWM_SetConfig(&(Treehopper_PeripheralConfig[1]));
		break;

	case LedConfig:
		LED_SetVal(Treehopper_PeripheralConfig[1]);
		break;

	case SPIConfig:
		SPI_SetConfig(Treehopper_PeripheralConfig[1]);
		break;
	case SPITransaction:
		spiConfig.CsPin = Treehopper_PeripheralConfig[1];
		spiConfig.CsMode = Treehopper_PeripheralConfig[2];
		spiConfig.CkrVal = Treehopper_PeripheralConfig[3];
		spiConfig.SpiMode = Treehopper_PeripheralConfig[4];

		burst = Treehopper_PeripheralConfig[5];
		totalTransactionBytes = Treehopper_PeripheralConfig[6];

		// check to see if we need to fetch more bytes for large transactions
		if(burst != Burst_Rx && totalTransactionBytes > 64-7 )
		{
			timeout = 0;
			// we can request all the remaining bytes at once; just hang in while() until they all come in.
			Treehopper_PeripheralConfigMultiRead = 1;
			USBD_Read(EP_PeripheralConfig, &Treehopper_PeripheralConfig[64], (totalTransactionBytes+7)-64, false);
			while(timeout++ < 65000 && USBD_EpIsBusy(EP_PeripheralConfig));
			Treehopper_PeripheralConfigMultiRead = 0;
			// Two ways this read did not deliver what was asked for: it never finished inside the
			// spin budget, or a re-enumeration re-armed the endpoint at offset 0 underneath it -
			// the ISR latches the desync bit for that second case. Either way the host is still
			// sending, or has just stopped sending, bytes we cannot place.
			//
			// The unconditional USBD_AbortTransfer that used to sit here ran on the healthy path
			// too, where it did nothing. On this path it discards up to two in-flight packets
			// while the host keeps sending, and the re-arm at the bottom of this function then
			// goes back to offset 0 - landing the next surviving packet where an opcode is
			// expected. Latch it so the drain throws those bytes away.
			if (Treehopper_PeripheralConfigDesync || USBD_EpIsBusy(EP_PeripheralConfig))
			{
				USBD_AbortTransfer(EP_PeripheralConfig);
				Treehopper_PeripheralConfigDesync = 1;
				break; // the payload is incomplete; do not run the transaction on it
			}
		}

		SPI_Transaction(&spiConfig, totalTransactionBytes, &Treehopper_PeripheralConfig[7], Treehopper_RxBuffer);

		// if we're doing a Tx burst, we don't care about Rx data -- don't bother sending it
		if (burst != Burst_Tx) {
			timeout = 0;
			USBD_Write(EP_PeripheralResponse, Treehopper_RxBuffer, totalTransactionBytes, false);
			while(timeout++ < 65000 && USBD_EpIsBusy(EP_PeripheralResponse));
			USBD_AbortTransfer(EP_PeripheralResponse);
		}
		break;

	case I2CConfig:
		I2C_SetConfig((I2cConfigData_t*) &(Treehopper_PeripheralConfig[1]));
		break;

	case I2CTransaction:
		totalTransactionBytes = Treehopper_PeripheralConfig[2];
		totalReadBytes = Treehopper_PeripheralConfig[3];

		if(totalTransactionBytes > 64-4)
		{
		   // we've only read 64 bytes into our buffer, so for long transactions read the remaining data
			timeout = 0;
			Treehopper_PeripheralConfigMultiRead = 1;
			USBD_Read(EP_PeripheralConfig, &Treehopper_PeripheralConfig[64], (totalTransactionBytes+4)-64, false);
			while(timeout++ < 65000 && USBD_EpIsBusy(EP_PeripheralConfig));
			Treehopper_PeripheralConfigMultiRead = 0;
			if (Treehopper_PeripheralConfigDesync || USBD_EpIsBusy(EP_PeripheralConfig))
			{
				// Same abandoned-remainder case as SPITransaction above.
				USBD_AbortTransfer(EP_PeripheralConfig);
				Treehopper_PeripheralConfigDesync = 1;
				break; // the payload is incomplete; do not run the transaction on it
			}
		}

		I2C_Transaction(Treehopper_PeripheralConfig[1], &Treehopper_PeripheralConfig[4],
						Treehopper_RxBuffer, totalTransactionBytes, totalReadBytes);

		timeout = 0;
		USBD_Write(EP2IN, Treehopper_RxBuffer, totalReadBytes+1, false);
		while(timeout++ < 65000 && USBD_EpIsBusy(EP_PeripheralResponse));
		USBD_AbortTransfer(EP_PeripheralResponse);
		break;

	case UARTConfig:
		UART_SetConfig((UartConfigData_t*) &(Treehopper_PeripheralConfig[1]));
		break;

	case UARTTransaction:
		UART_Transaction(&(Treehopper_PeripheralConfig[1]));
		break;

	case FirmwareUpdateSerial:
		SerialNumber_update(&(Treehopper_PeripheralConfig[2]),
				Treehopper_PeripheralConfig[1]);
		break;

	case FirmwareUpdateName:
		SerialNumber_updateName(&(Treehopper_PeripheralConfig[2]),
				Treehopper_PeripheralConfig[1]);
		break;

	case SoftPwmConfig:
		SoftPwm_SetConfig((softPwmPinConfig_t*)&(Treehopper_PeripheralConfig[2]),
				Treehopper_PeripheralConfig[1]);
		break;

	case Reboot:
		USBD_Stop();
		SFRPAGE = 0x00;
		RSTSRC = RSTSRC_SWRSF__SET | RSTSRC_PORSF__SET;
		break;

	case EnterBootloader:
		USBD_Stop();
		*((uint8_t SI_SEG_DATA *) 0x00) = 0xA5;
		SFRPAGE = 0x00;
		RSTSRC = RSTSRC_SWRSF__SET | RSTSRC_PORSF__SET;
		break;

	case ParallelConfig:
		Parallel_SetConfig(&(Treehopper_PeripheralConfig[1]));
		break;

	case ParallelTransaction:
		Parallel_Transaction(&(Treehopper_PeripheralConfig[1]));
		break;
	}

	memset(Treehopper_PeripheralConfig, 0, sizeof(Treehopper_PeripheralConfig)); // reset the buffer to zero to avoid accidentally re-processing data
	// Clear the short-packet bit as the read is armed, so it can only ever be true because the
	// ISR set it for THIS packet. Left over from the previous transfer it is a stale boundary:
	// the drain would read a short packet that ended some earlier command as the end of the one
	// it is currently discarding, and resynchronise a packet early.
	Treehopper_PeripheralConfigShortPacket = 0;
	// when we're all done, re-arm the endpoint. The completion callback is enabled (the
	// trailing `true`) purely so the ISR can record whether the packet was short; that is the
	// only signal the drain above has for finding the next real packet boundary.
	USBD_Read(EP_PeripheralConfig, Treehopper_PeripheralConfig, 64, true);
}
